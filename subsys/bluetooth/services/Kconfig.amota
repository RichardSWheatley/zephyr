## subsys/bluetooth/services/Kconfig.amota
```kconfig
#
# Copyright (c) 2023 Ambiq Micro Inc.
#
# SPDX-License-Identifier: Apache-2.0

menuconfig BT_AMOTA
	bool "AMOTA service"
	help
	  Enable Ambiq GATT AMOTA BLE service.

if BT_AMOTA

config BT_AMOTA_MAX_IMAGE_SIZE
	hex "Maximum application image size"
	default 0x80000
	help
	  Size reserved for the running application image, starting at the
	  application load address. The OTA descriptor is placed right after
	  this area and the incoming image is staged after the descriptor, up
	  to the end of MRAM. Must be a multiple of 1 KiB and larger than the
	  application image, or an update erases the running application.

config BT_AMOTA_REQUIRE_ENCRYPTION
	bool "Accept firmware only over an encrypted link"
	depends on BT_SMP
	help
	  Enabling AMOTA notifications and writing AMOTA packets need an
	  encrypted (paired) link, so a device in radio range cannot replace
	  the firmware without pairing first. The notification enable is a
	  write request, so the client gets "insufficient encryption" and
	  pairs; packet writes are write commands and are dropped silently
	  on an unencrypted link.

config BT_AMOTA_IDLE_TIMEOUT
	int "OTA idle timeout in seconds"
	default 60
	range 0 600
	help
	  Maximum time without any AMOTA GATT write while a firmware transfer
	  is in progress (AMOTA_STATE_GETTING_FW). On expiry the device notifies
	  the client with AMOTA_STATUS_TIMEOUT and the current flash offset.
	  Set to 0 to disable.

config BT_AMOTA_PARTIAL_PKT_TIMEOUT
	int "Partial packet reassembly timeout in seconds"
	default 10
	range 0 120
	help
	  Maximum time to wait for remaining chunks of a partially received
	  AMOTA packet. On expiry the partial reassembly buffer is discarded
	  and the client is notified so it can retry the packet. Set to 0 to
	  disable (falls back to the idle timeout when that is enabled).

config BT_AMOTA_IDLE_DISCONNECT
	bool "Disconnect BLE link on OTA idle timeout"
	default y
	depends on BT_AMOTA_IDLE_TIMEOUT > 0
	help
	  When the OTA idle timeout fires, disconnect the BLE link after
	  notifying the client. This helps phone apps that do not handle
	  AMOTA_STATUS_TIMEOUT recover by reconnecting.

module = BT_AMOTA
module-str = amota
source "subsys/logging/Kconfig.template.log_config"

endif # BT_AMOTA
```

## tests/renode-mve-smoke/testcase.yaml
```yaml
# Copyright (c) 2026 Ambiq Micro Inc.
# SPDX-License-Identifier: Apache-2.0

tests:
  arch.arm.mve.smoke:
    tags:
      - mve
      - simulation
    filter: CONFIG_CPU_CORTEX_M55
    platform_allow:
      - apollo510_evb/apollo510
      - mps3/corstone300/an547
    harness: console
    harness_config:
      type: one_line
      regex:
        - "MVE smoke: PASS"
```

## tests/renode-stimer-compcap/testcase.yaml
```yaml
# Copyright (c) 2026 Ambiq Micro Inc.
# SPDX-License-Identifier: Apache-2.0

tests:
  boards.apollo510_evb.stimer.compcap:
    tags:
      - stimer
      - simulation
    platform_allow:
      - apollo510_evb/apollo510
    harness: robot
    harness_config:
      robot_testsuite: compcap.robot
```
